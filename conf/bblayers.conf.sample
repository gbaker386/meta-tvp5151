## conf/bblayers.conf.sample
```bitbake
# LAYER_CONF_VERSION is increased each time build/conf/bblayers.conf
# changes incompatibly
LCONF_VERSION = "6"

BBPATH = "${TOPDIR}"
BBFILES ?= ""

BBLAYERS ?= " \
  /home/scott/poky-dylan/meta \
  /home/scott/poky-dylan/meta-yocto \
  /home/scott/poky-dylan/meta-openembedded/meta-oe \
  /home/scott/poky-dylan/meta-openembedded/meta-networking \
  /home/scott/poky-dylan/meta-gumstix \
  /home/scott/tvp5151/meta-ti \
  /home/scott/tvp5151/meta-tvp5151 \
  "

BBLAYERS_NON_REMOVABLE ?= " \
  /home/scott/poky-dylan/meta \
  /home/scott/poky-dylan/meta-yocto \
  "
```

## conf/layer.conf
```bitbake
# We have a conf and classes directory, append to BBPATH
BBPATH .= ":${LAYERDIR}"

# We have a recipes directory, add to BBFILES
BBFILES += "${LAYERDIR}/recipes*/*/*.bb ${LAYERDIR}/recipes*/*/*.bbappend"

BBFILE_COLLECTIONS += "meta-tvp5151"
BBFILE_PATTERN_meta-tvp5151 := "^${LAYERDIR}/"
BBFILE_PRIORITY_meta-tvp5151 = "16"
```
